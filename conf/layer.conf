## conf/layer.conf
```bitbake
# We have a conf and classes directory, add to BBPATH
BBPATH .= ":${LAYERDIR}"

# We have recipes-* directories, add to BBFILES
BBFILES += "${LAYERDIR}/recipes-*/*/*.bb \
            ${LAYERDIR}/recipes-*/*/*.bbappend"

BBFILE_COLLECTIONS += "meta-tis-ic4"
BBFILE_PATTERN_meta-tis-ic4 = "^${LAYERDIR}/"
BBFILE_PRIORITY_meta-tis-ic4 = "6"

LAYERDEPENDS_meta-tis-ic4 = "core"
LAYERSERIES_COMPAT_meta-tis-ic4 = "scarthgap"
```
